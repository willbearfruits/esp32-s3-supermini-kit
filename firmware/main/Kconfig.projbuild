## firmware/main/Kconfig.projbuild
```kconfig
menu "Kit firmware"

    choice KIT_APP
        prompt "Application"
        default KIT_APP_LOOPER
        help
            Which program the board runs. Both share the audio engine, voice
            tracker, OLED driver and self-test.

        config KIT_APP_LOOPER
            bool "Voice looper (drums, bass, chords, lead, vocal)"
        config KIT_APP_INSTRUMENT
            bool "Voice instrument (vocoder, autotune, guitar, delay, ...)"
        config KIT_APP_TEST
            bool "Hardware test (sine sweep on the DACs)"
    endchoice

    config KIT_LOOP_MAX_SEC
        int "Looper: vocal buffer size in seconds"
        range 2 16
        default 8
        depends on KIT_APP_LOOPER
        help
            Longest loop a vocal pattern can hold, one byte per sample in
            PSRAM. Four vocal patterns are kept, so 8 s costs 1 MB.

    config KIT_MIC_GAIN
        int "Mic gain (linear multiplier)"
        range 1 64
        default 8
        help
            The INMP441 is fairly quiet. Samples are multiplied by this
            before anything else sees them.

    config KIT_GATE_DB
        int "Voice gate threshold (dBFS, after mic gain)"
        range -80 0
        default -42
        help
            The instrument only reacts while the mic is louder than this.
            The gate closes 8 dB below it, after a short hold.

    config KIT_BPM
        int "Tempo (bpm)"
        range 40 240
        default 100
        help
            The looper's fixed tempo, and the tempo of the instrument's
            delay and stutter modes.

    config KIT_LOOP_BARS
        int "Looper: loop length in bars"
        range 1 8
        default 2
        depends on KIT_APP_LOOPER

    config KIT_AMP_ALWAYS_ON
        bool "Keep the speaker amp on all the time"
        default n
        help
            By default the MAX98357A is only enabled while the encoder button
            is held, because mic -> speaker feedback howls. Enable this if you
            have no encoder wired yet or want to test the speaker freely.

    config KIT_ENC_STEPS
        int "Encoder counts per detent"
        range 1 4
        default 4
        help
            Most EC11 encoders give 4 quadrature edges per click; some give 2.

    config KIT_OLED_FLIP
        bool "Rotate the OLED 180 degrees"
        default y
        help
            Set to match how the panel is mounted; the header end of the
            module is the top when this is off.

    config KIT_SAMPLE_RATE
        int "Sample rate (Hz)"
        default 32000
        help
            Shared by mic and both DACs. 32000 gives 16 kHz of bandwidth,
            which is what the hats and sibilants need; the S3 has the CPU
            for it. 16000 halves every buffer if RAM gets tight.

    config KIT_ONSET_DB
        int "Beatbox onset threshold above the noise floor (dB)"
        range 6 40
        default 20
        depends on KIT_APP_LOOPER
        help
            A hit must exceed the tracked background noise by this much,
            and jump by at least 8 dB, before it counts as a drum.

endmenu
```
