#include "tof.h"
#include "esp_log.h"
#include "freertos/FreeRTOS.h"
#include "freertos/task.h"

static const char *TAG = "tof";
static i2c_master_dev_handle_t dev;
static bool present;
static uint8_t stop_var;

static bool wr(uint8_t r, uint8_t v) { uint8_t b[2] = { r, v }; return i2c_master_transmit(dev, b, 2, 50) == ESP_OK; }
static uint8_t rd(uint8_t r) { uint8_t v = 0; i2c_master_transmit_receive(dev, &r, 1, &v, 1, 50); return v; }
static uint16_t rd16(uint8_t r) { uint8_t b[2] = { 0, 0 }; i2c_master_transmit_receive(dev, &r, 1, b, 2, 50); return b[0] << 8 | b[1]; }

static const uint8_t TUNING[][2] = {
    {0xFF,0x01},{0x00,0x00},{0xFF,0x00},{0x09,0x00},{0x10,0x00},{0x11,0x00},{0x24,0x01},{0x25,0xFF},{0x75,0x00},
    {0xFF,0x01},{0x4E,0x2C},{0x48,0x00},{0x30,0x20},{0xFF,0x00},{0x30,0x09},{0x54,0x00},{0x31,0x04},{0x32,0x03},
    {0x40,0x83},{0x46,0x25},{0x60,0x00},{0x27,0x00},{0x50,0x06},{0x51,0x00},{0x52,0x96},{0x56,0x08},{0x57,0x30},
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    {0xFF,0x00},{0x80,0x01},{0x01,0xF8},{0xFF,0x01},{0x8E,0x01},{0x00,0x01},{0xFF,0x00},{0x80,0x00},
};

static bool wait_bit(uint8_t reg, uint8_t mask, bool set)
{
    for (int i = 0; i < 100; i++) {
        uint8_t v = rd(reg);
        if (set ? (v & mask) : !(v & mask)) return true;
        vTaskDelay(1);
    }
    return false;
}

static bool ref_cal(uint8_t vhv)
{
    wr(0x00, 0x01 | vhv);
    if (!wait_bit(0x13, 0x07, true)) return false;
    wr(0x0B, 0x01); wr(0x00, 0x00);
    return true;
}

bool tof_init(i2c_master_bus_handle_t bus)
{
    if (i2c_master_probe(bus, 0x29, 20) != ESP_OK) { ESP_LOGI(TAG, "no VL53L0X"); return false; }
    i2c_device_config_t cfg = { .dev_addr_length = I2C_ADDR_BIT_LEN_7, .device_address = 0x29, .scl_speed_hz = 400000 };
    if (i2c_master_bus_add_device(bus, &cfg, &dev) != ESP_OK) return false;
    if (rd(0xC0) != 0xEE) { ESP_LOGW(TAG, "wrong model id"); return false; }

    wr(0x88, 0x00);
    wr(0x80, 0x01); wr(0xFF, 0x01); wr(0x00, 0x00);
    stop_var = rd(0x91);
    wr(0x00, 0x01); wr(0xFF, 0x00); wr(0x80, 0x00);
    wr(0x60, rd(0x60) | 0x12);                       // MSRC: disable signal rate and pre-range limit checks
    wr(0x44, 0x00); wr(0x45, 0x20);                  // signal rate limit 0.25 MCPS (16-bit 9.7 fixed point)
    wr(0x01, 0xFF);

    // SPAD map
    wr(0x80, 0x01); wr(0xFF, 0x01); wr(0x00, 0x00); wr(0xFF, 0x06);
    wr(0x83, rd(0x83) | 0x04);
    wr(0xFF, 0x07); wr(0x81, 0x01); wr(0x80, 0x01); wr(0x94, 0x6B); wr(0x83, 0x00);
    if (!wait_bit(0x83, 0xFF, true)) return false;
    wr(0x83, 0x01);
    uint8_t tmp = rd(0x92);
    int spad_count = tmp & 0x7F; bool aperture = (tmp >> 7) & 1;
    wr(0x81, 0x00); wr(0xFF, 0x06);
    wr(0x83, rd(0x83) & ~0x04);
    wr(0xFF, 0x01); wr(0x00, 0x01); wr(0xFF, 0x00); wr(0x80, 0x00);
    uint8_t map[6], reg = 0xB0;
    i2c_master_transmit_receive(dev, &reg, 1, map, 6, 50);
    wr(0xFF, 0x01); wr(0x4F, 0x00); wr(0x4E, 0x2C); wr(0xFF, 0x00); wr(0xB6, 0xB4);
    int first = aperture ? 12 : 0, enabled = 0;
    for (int i = 0; i < 48; i++) {
        if (i < first || enabled == spad_count) map[i / 8] &= ~(1 << (i % 8));
        else if ((map[i / 8] >> (i % 8)) & 1) enabled++;
    }
    { uint8_t b[7] = { 0xB0, map[0], map[1], map[2], map[3], map[4], map[5] }; i2c_master_transmit(dev, b, 7, 50); }

    for (unsigned i = 0; i < sizeof TUNING / sizeof TUNING[0]; i++) wr(TUNING[i][0], TUNING[i][1]);
    wr(0x0A, 0x04); wr(0x84, rd(0x84) & ~0x10); wr(0x0B, 0x01);   // interrupt on new sample, active low
    wr(0x01, 0xE8);
    wr(0x01, 0x01); if (!ref_cal(0x40)) return false;
    wr(0x01, 0x02); if (!ref_cal(0x00)) return false;
    wr(0x01, 0xE8);

    // continuous back-to-back
    wr(0x80, 0x01); wr(0xFF, 0x01); wr(0x00, 0x00); wr(0x91, stop_var);
    wr(0x00, 0x01); wr(0xFF, 0x00); wr(0x80, 0x00);
    wr(0x00, 0x02);
    present = true;
    ESP_LOGI(TAG, "VL53L0X ready, %d spads", spad_count);
    return true;
}

bool tof_present(void) { return present; }

int tof_poll(void)
{
    if (!present) return -1;
    if ((rd(0x13) & 0x07) == 0) return -1;
    int mm = rd16(0x14 + 10);
    wr(0x0B, 0x01);
    return mm >= 8000 || mm <= 0 ? -1 : mm;
}
